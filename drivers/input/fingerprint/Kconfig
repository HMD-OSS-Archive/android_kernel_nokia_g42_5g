## drivers/input/fingerprint/Kconfig
```kconfig
#
#Fingerprint
#
menuconfig INPUT_FINGERPRINT
	  tristate "Fingerprint Config Choosen"
	  default y
	  help
	  Say Y to can config finperprint manufacturer

source "drivers/input/fingerprint/fps_chipone_Q00/Kconfig"
source "drivers/input/fingerprint/fps_focaltech_Q00/Kconfig"
```

## drivers/input/touchscreen/chipone-tddi/Kconfig
```kconfig
#
# Focaltech Touchscreen driver configuration
#

config TOUCHSCREEN_CHIPONE
    tristate "Chipone Touchscreen"
    default n
    help
      Say Y here if you have Focaltech touch panel.
      If unsure, say N.
```

## drivers/input/touchscreen/ilitek_v3_touch/Kconfig
```kconfig
#
# Focaltech Touchscreen driver configuration
#

config TOUCHSCREEN_ILI_V3
    bool "ili_v3 Touchscreen"
    default n
    help
      Say Y here if you have Focaltech touch panel.
      If unsure, say N.
      
```

## drivers/nfc/tmsdrv/Kconfig
```kconfig
#
# TMS devices
#

menu "TMS devices support"

config TMS_DEVICE
    tristate "TMS Driver"
    help
        Say Y here if you have TMS device.

source "drivers/nfc/tmsdrv/nfc/Kconfig"
source "drivers/nfc/tmsdrv/guidev/Kconfig"
endmenu
```

## drivers/ontim/hwinfo/Kconfig
```kconfig
menu "ONTIM hardware info"

config ONTIM_HWINFO
	tristate "Product Hardward Info and boardid"
	help
	  Say Y or M here if you want to build Product Hardward Info and gpio boardid.

config HBM_SUPPORT
        bool "HBM NODE SUPPORT"
	default n
        help
	  HBM node support, say y,will create this node

endmenu
```
